## main/Kconfig.projbuild
```kconfig
menu "Application Configuration"

	config GPIO_RANGE_MAX
		int
		default 33 if IDF_TARGET_ESP32
		default 46 if IDF_TARGET_ESP32S2
		default 48 if IDF_TARGET_ESP32S3
		default 19 if IDF_TARGET_ESP32C3
		default 30 if IDF_TARGET_ESP32C6

	menu "CAN Setting"

		config CTX_GPIO
			int "CTX GPIO number"
			range 0 GPIO_RANGE_MAX
			default 21 if IDF_TARGET_ESP32
			default  0 if IDF_TARGET_ESP32S2 || IDF_TARGET_ESP32S3
			default  0 # C3 and others
			help
				GPIO number (IOxx) to CTX.
				Some GPIOs are used for other purposes (flash connections, etc.).
				GPIOs 35-39 are input-only so cannot be used as outputs.

		config CRX_GPIO
			int "CRX GPIO number"
			range 0 GPIO_RANGE_MAX
			default 22 if IDF_TARGET_ESP32
			default  1 if IDF_TARGET_ESP32S2 || IDF_TARGET_ESP32S3
			default  1 # C3 and others
			help
				GPIO number (IOxx) to CRX.
				Some GPIOs are used for other purposes (flash connections, etc.).
				GPIOs 35-39 are input-only so cannot be used as outputse

	endmenu

	menu "UART Setting"

		choice INTERFACE
			prompt "Interface"
			default UART_INTERFACE
			help
				Select Interface.
			config UART_INTERFACE
				bool "UART Interface"
				help
					UART Interface.
			config USB_INTERFACE
				depends on IDF_TARGET_ESP32S2 || IDF_TARGET_ESP32S3
				bool "USB Interface"
				help
					USB Interface.
		endchoice

		config UART_TX_GPIO
			depends on UART_INTERFACE
			int "UART TX GPIO number"
			range 0 GPIO_RANGE_MAX
			default  4 if IDF_TARGET_ESP32
			default  4 if IDF_TARGET_ESP32S2 || IDF_TARGET_ESP32S3
			default  4 # C3 and others
			help
				GPIO number (IOxx) to UART TX.
				Some GPIOs are used for other purposes (flash connections, etc.).
				GPIOs 35-39 are input-only so cannot be used as outputs.

		config UART_RX_GPIO
			depends on UART_INTERFACE
			int "UART RX GPIO number"
			range 0 GPIO_RANGE_MAX
			default  5 if IDF_TARGET_ESP32
			default  5 if IDF_TARGET_ESP32S2 || IDF_TARGET_ESP32S3
			default  5 # C3 and others
			help
				GPIO number (IOxx) to UART RX.
				Some GPIOs are used for other purposes (flash connections, etc.).
				GPIOs 35-39 are input-only so cannot be used as outputs.

	endmenu

endmenu
```
